// SPDX-License-Identifier: (GPL-2.0+ OR MIT)
/*
 * Copyright (c) 2024 BuildJet, Inc.
 * Copyright (c) 2022 Rockchip Electronics Co., Ltd.
 */

/dts-v1/;

#include "rv1106.dtsi"
#include "rv1106-evb.dtsi"
#include "rv1106-jetkvm-v2.dtsi"

/**********eMMC**********/
&emmc {
	bus-width = <8>;
	cap-mmc-highspeed;
	non-removable;
	rockchip,default-sample-phase = <90>;
	no-sdio;
	no-sd;
	post-power-on-delay-ms = <0>;
	status = "okay";
};
