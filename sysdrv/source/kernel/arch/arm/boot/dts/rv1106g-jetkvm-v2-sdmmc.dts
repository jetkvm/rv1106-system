// SPDX-License-Identifier: (GPL-2.0+ OR MIT)
/*
 * Copyright (c) 2024 BuildJet, Inc.
 * Copyright (c) 2022 Rockchip Electronics Co., Ltd.
 */

/dts-v1/;

#include "rv1106.dtsi"
#include "rv1106-evb.dtsi"
#include "rv1106-jetkvm-v2.dtsi"

/**********SDMMC / TF Card**********/
&sdmmc {
	max-frequency = <50000000>;
	no-mmc;
	bus-width = <4>;
	cap-sd-highspeed;
	disable-wp;
	cap-sdio-irq;
	non-removable;
	no-1-8-v;
	supports-sdio;
	pinctrl-names = "default";
	pinctrl-0 = <&sdmmc0_clk &sdmmc0_cmd &sdmmc0_det &sdmmc0_bus4>;
	status = "okay";
};
